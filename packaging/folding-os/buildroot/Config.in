## packaging/folding-os/buildroot/Config.in
```kconfig
menu "FoldOps"

config BR2_FOLDOPS_CARGO_OFFLINE
	bool "Use vendored Cargo dependencies (offline build)"
	default y
	depends on BR2_PACKAGE_HOST_RUSTC_TARGET_ARCH_SUPPORTS
	help
	  Require vendor/ in the foldops source tree (see scripts/vendor-rust-deps.sh).
	  Disable only if the Buildroot host has network during cargo build.

source "$BR2_EXTERNAL_FOLDING_OS_PATH/build/packages/foldops-agent/Config.in"
source "$BR2_EXTERNAL_FOLDING_OS_PATH/build/packages/foldops-supervisor/Config.in"

endmenu
```

## packaging/folding-os/buildroot/foldops-agent/Config.in
```kconfig
config BR2_PACKAGE_FOLDOPS_AGENT
	bool "foldops-agent"
	depends on BR2_PACKAGE_HOST_RUSTC_TARGET_ARCH_SUPPORTS
	help
	  FoldOps metrics collector for Folding@home farm nodes.
	  Posts ingest payloads to the supervisor and exposes a local HTTP API.

	  https://github.com/pacificnm/foldops
```

## packaging/folding-os/buildroot/foldops-supervisor/Config.in
```kconfig
config BR2_PACKAGE_FOLDOPS_SUPERVISOR
	bool "foldops-supervisor"
	depends on BR2_PACKAGE_HOST_RUSTC_TARGET_ARCH_SUPPORTS
	help
	  FoldOps supervisor API, SQLite store, alerts, and React dashboard.
	  Typically enabled on one management node (e.g. fah-01).

	  Requires prebuilt web assets (apps/supervisor/web/dist) in the
	  foldops source tree — produced by CI on release tags or
	  `npm run build:web` before image build.

	  https://github.com/pacificnm/foldops
```
